## boards/shields/my_keyboard/Kconfig.defconfig
```kconfig
if SHIELD_MY_KEYBOARD

# 名前は16文字以内
config ZMK_KEYBOARD_NAME
    default "My Keyboard"

endif
```

## boards/shields/my_keyboard/Kconfig.shield
```kconfig
# カンマの後、キーボード名には空白禁止。
config SHIELD_MY_KEYBOARD
    def_bool $(shields_list_contains,my_keyboard)
```
